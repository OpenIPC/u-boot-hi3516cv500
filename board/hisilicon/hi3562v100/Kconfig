## board/hisilicon/hi3562v100/Kconfig
```kconfig
if TARGET_HI3562V100

config SYS_BOARD
	default "hi3562v100"

config SYS_VENDOR
	default "hisilicon"

config SYS_SOC
	default "hi3562v100"

config SYS_CONFIG_NAME
	default "hi3562v100"

endif
```

## board/hisilicon/hi3566v100/Kconfig
```kconfig
if TARGET_HI3566V100

config SYS_BOARD
	default "hi3566v100"

config SYS_VENDOR
	default "hisilicon"

config SYS_SOC
	default "hi3566v100"

config SYS_CONFIG_NAME
	default "hi3566v100"

endif
```

## board/hisilicon/hi3569v100/Kconfig
```kconfig
if TARGET_HI3569V100

config SYS_BOARD
	default "hi3569v100"

config SYS_VENDOR
	default "hisilicon"

config SYS_SOC
	default "hi3569v100"

config SYS_CONFIG_NAME
	default "hi3569v100"

endif
```
